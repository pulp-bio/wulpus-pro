## fw/esp32/components/bsp/Kconfig.projbuild
```kconfig
menu "BSP settings"

    config BSP_INIT_LED
        bool "Initialize the boards LED"
        default y
        help
          This option controls whether the LED is initialized by the BSP.

    config BSP_DEFAULT_LED_BRIGHTNESS
        
        int "Default LED brightness"
        default 10
        range 0 255
        help
          This is the default brightness for the LEDs.  It can be
          overridden by passing a brightness value in the `bsp_set_led()` call.

    config BSP_LED_PIN

        int "LED pin"
        default 48
        help
          This is the pin that the LED is connected to.

endmenu
```

## fw/esp32/components/mdns_manager/Kconfig.projbuild
```kconfig
menu "mdns_manager Configuration"

    config MDNS_MANAGER_POSTPENDMAC
        bool "Postpend MAC address to hostname"
        default n
        help
          Postpend MAC address to hostname

endmenu
```

## fw/esp32/components/provisioner/Kconfig.projbuild
```kconfig
menu "provisioner Configuration"

    config PROVISIONER_RESET_ON_FAILURE
        bool "Reset on failure"
        default y
        help
          Reset the provisioner on failure.

    config PROVISIONER_RESET_ON_FAILURE_TRIES
        int "Reset on failure tries"
        default 3
        depends on PROVISIONER_RESET_ON_FAILURE
        help
          Number of tries before reseting the provisioner.

    config PROVISIONER_POP
        string "Proof of possession password"
        default "abcd1234"
        help
          Proof of possession password which will be used in the provisioning process.

endmenu
```

## fw/esp32/main/Kconfig.projbuild
```kconfig
menu "WULPUS PRO Configuration"

    menu "Power Management"

    config WP_ENABLE_PM
        bool "Enable power management"
        default y
        help
            This enables power management.
    
    config WP_PM_MIN_FREQUENCY
        int "Minimum frequency for DFS"
        default 10
        range 1 100
        help
            This sets the minimum frequency for DFS in MHz.
            The default value is 10 MHz.
        depends on WP_ENABLE_PM

    endmenu

    menu "Double Reset"

    config WP_DOUBLE_RESET
        bool "Double reset detection"
        default y
        help
            This erases the NVS to reset provisioned status of the device on double reset.

    config WP_DOUBLE_RESET_TIMEOUT
        int "Double reset timeout [ms]"
        default 2000
        range 1000 20000
        help
            This sets the timeout for double reset detection in milliseconds.
            The default value is 2000 milliseconds.
        depends on WP_DOUBLE_RESET

    endmenu

    menu "Networking"

    config WP_SOCKET_PORT
        int "Socket port"
        default 2121
        range 1 65535
        help
            This sets the socket port for the server.
            The default value is 2121.

    config WP_SERVER_STACK_SIZE
        int "Server task stack size [bytes]"
        default 4096
        range 1024 16384
        help
            This sets the server task stack size in bytes.
            The default value is 4096 bytes.

    config WP_SERVER_PRIORITY
        int "Server task priority"
        default 5
        range 1 10
        help
            This sets the server task priority.
            The default value is 5.

    config WP_SERVER_RX_BUFFER_SIZE
        int "Server RX buffer size [bytes]"
        default 128
        range 32 8192
        help
            This sets the server RX buffer size in bytes.
            The default value is 128 bytes.

    endmenu

    menu "SPI"

    config WP_SPI_INSTANCE
        int "SPI instance (1 or 2)"
        default 1
        range 1 2
        help
            This sets the SPI instance to use.
            The default value is 1.

    config WP_SPI_MISO
        int "SPI MISO pin"
        default 12
        range 0 39
        help
            This sets the SPI MISO pin.
            The default value is 12.
    
    config WP_SPI_MOSI
        int "SPI MOSI pin"
        default 13
        range 0 39
        help
            This sets the SPI MOSI pin.
            The default value is 13.
    
    config WP_SPI_CLK
        int "SPI CLK pin"
        default 14
        range 0 39
        help
            This sets the SPI CLK pin.
            The default value is 14.

    config WP_SPI_CS
        int "SPI CS pin"
        default 15
        range 0 39
        help
            This sets the SPI CS pin.
            The default value is 15.

    config WP_SPI_MAX_TRANSFER_SIZE
        int "SPI max transfer size [bytes]"
        default 1024
        range 32 8192
        help
            This sets the maximum transfer size for SPI in bytes.
            The default value is 1024 bytes.

    config WP_SPI_CLOCK_SPEED
        int "SPI clock speed [Hz]"
        default 8000000
        range 100000 50000000
        help
            This sets the SPI clock speed in Hz.
            The default value is 8 MHz.

    endmenu

    menu "GPIO"

    config WP_GPIO_LINK_READY
        int "Link ready GPIO pin"
        default 2
        range 0 39
        help
            This sets the link ready GPIO pin.
            The default value is 2.

    config WP_GPIO_DATA_READY
        int "Data ready GPIO pin"
        default 4
        range 0 39
        help
            This sets the data ready GPIO pin.
            The default value is 4.

    endmenu

    menu "Data Handling"

    config WP_HANDLER_STACK_SIZE
        int "Data handler stack size [bytes]"
        default 2048
        range 1024 16384
        help
            This sets the data handler stack size in bytes.
            The default value is 2048 bytes.

    config WP_HANDLER_PRIORITY
        int "Data handler task priority"
        default 6
        range 1 10
        help
            This sets the data handler task priority.
            The default value is 6.

    config WP_DATA_RX_LENGTH
        int "Data RX length [bytes]"
        default 804
        range 32 8192
        help
            This sets the data RX length in bytes.
            The default value is 804 bytes.

    endmenu

endmenu
```

## fw/esp32/sdkconfig.defaults.esp32c6
```kconfig
CONFIG_IDF_TARGET="esp32c6"

CONFIG_BSP_LED_PIN=8

CONFIG_ESPTOOLPY_FLASHSIZE_8MB=y
CONFIG_ESPTOOLPY_FLASHSIZE="8MB"

CONFIG_ESP32_WIFI_STATIC_RX_BUFFER_NUM=20
CONFIG_ESP32_WIFI_DYNAMIC_RX_BUFFER_NUM=40
CONFIG_ESP32_WIFI_DYNAMIC_TX_BUFFER_NUM=128
CONFIG_ESP32_WIFI_RX_BA_WIN=32
CONFIG_ESP32_WIFI_TX_BA_WIN=64

CONFIG_LWIP_TCP_SND_BUF_DEFAULT=40000
CONFIG_LWIP_TCP_WND_DEFAULT=40000
CONFIG_LWIP_UDP_RECVMBOX_SIZE=16
```

## fw/esp32/sdkconfig.defaults.esp32s3
```kconfig
CONFIG_IDF_TARGET="esp32s3"

CONFIG_BSP_LED_PIN=48

CONFIG_ESPTOOLPY_FLASHSIZE_16MB=y
CONFIG_ESPTOOLPY_FLASHSIZE="16MB"

CONFIG_SPIRAM=y
CONFIG_SPIRAM_MODE_OCT=y
CONFIG_SPIRAM_SPEED_80M=y

CONFIG_ESP_DEFAULT_CPU_FREQ_MHZ_240=y

CONFIG_ESP32S3_INSTRUCTION_CACHE_32KB=y
CONFIG_ESP32S3_DATA_CACHE_64KB=y

CONFIG_ESP32_WIFI_STATIC_RX_BUFFER_NUM=24
CONFIG_ESP32_WIFI_DYNAMIC_RX_BUFFER_NUM=85
CONFIG_ESP32_WIFI_STATIC_TX_BUFFER_NUM=32
CONFIG_ESP32_WIFI_RX_BA_WIN=32

CONFIG_LWIP_UDP_RECVMBOX_SIZE=16
```
